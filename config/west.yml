## config/west.yml
```yaml
manifest:
  remotes:
    - name: zmk
      url-base: https://github.com/xpsking
  projects:
    - name: zmk
      remote: zmk
      revision: main
      import: app/west.yml
  self:
    path: config
```
